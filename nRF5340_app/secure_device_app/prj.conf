## CMakeLists.txt
```
# SPDX-License-Identifier: Apache-2.0

cmake_minimum_required(VERSION 3.20.0)
find_package(Zephyr REQUIRED HINTS $ENV{ZEPHYR_BASE})
project(secure_device_app)

FILE(GLOB app_sources src/*.c)
FILE(GLOB wrapper_sources wrapper/*.c)
target_sources(app PRIVATE
    ${app_sources}
    ${wrapper_sources}
    $ENV{NCS_HOME}/mbedtls/library/ctr_drbg.c
    ../../FIDO2Device/ctap2_lib/ctap2_cbor.c
    ../../FIDO2Device/ctap2_lib/ctap2_cbor_authgetinfo.c
    ../../FIDO2Device/ctap2_lib/ctap2_cbor_encode.c
    ../../FIDO2Device/ctap2_lib/ctap2_cbor_parse.c
    ../../FIDO2Device/ctap2_lib/ctap2_client_pin.c
    ../../FIDO2Device/ctap2_lib/ctap2_client_pin_token.c
    ../../FIDO2Device/ctap2_lib/ctap2_common.c
    ../../FIDO2Device/ctap2_lib/ctap2_extension_hmac_secret.c
    ../../FIDO2Device/ctap2_lib/ctap2_get_assertion.c
    ../../FIDO2Device/ctap2_lib/ctap2_make_credential.c
    ../../FIDO2Device/ctap2_lib/ctap2_pubkey_credential.c
    ../../FIDO2Device/fido2_lib/fido_ble_receive.c
    ../../FIDO2Device/fido2_lib/fido_ble_send.c
    ../../FIDO2Device/fido2_lib/fido_command.c
    ../../FIDO2Device/fido2_lib/fido_command_common.c
    ../../FIDO2Device/fido2_lib/fido_common.c
    ../../FIDO2Device/fido2_lib/fido_ctap2_command.c
    ../../FIDO2Device/fido2_lib/fido_hid_channel.c
    ../../FIDO2Device/fido2_lib/fido_hid_receive.c
    ../../FIDO2Device/fido2_lib/fido_hid_send.c
    ../../FIDO2Device/fido2_lib/fido_maintenance.c
    ../../FIDO2Device/fido2_lib/fido_maintenance_attestation.c
    ../../FIDO2Device/fido2_lib/fido_receive_apdu.c
    ../../FIDO2Device/fido2_lib/fido_u2f_command.c
    ../../FIDO2Device/u2f_lib/u2f_authenticate.c
    ../../FIDO2Device/u2f_lib/u2f_keyhandle.c
    ../../FIDO2Device/u2f_lib/u2f_register.c
    ../../FIDO2Device/u2f_lib/u2f_signature.c
    ../../CCID/ccid_lib/ccid_apdu.c
    ../../CCID/ccid_lib/ccid_main.c
    ../../CCID/ccid_lib/ccid_process.c
    ../../CCID/piv_lib/ccid_piv.c
    ../../CCID/piv_lib/ccid_piv_authenticate.c
    ../../CCID/piv_lib/ccid_piv_general_auth.c
    ../../CCID/piv_lib/ccid_piv_object.c
    ../../CCID/piv_lib/ccid_piv_object_import.c
    ../../CCID/piv_lib/ccid_piv_pin.c
    ../../CCID/piv_lib/ccid_piv_pin_auth.c
    ../../CCID/piv_lib/ccid_piv_pin_update.c
    ../../CCID/piv_lib/ccid_ykpiv.c
    ../../CCID/piv_lib/ccid_ykpiv_import_key.c
    ../../CCID/openpgp_lib/ccid_openpgp.c
    ../../CCID/openpgp_lib/ccid_openpgp_attr.c
    ../../CCID/openpgp_lib/ccid_openpgp_crypto.c
    ../../CCID/openpgp_lib/ccid_openpgp_data.c
    ../../CCID/openpgp_lib/ccid_openpgp_key.c
    ../../CCID/openpgp_lib/ccid_openpgp_key_rsa.c
    ../../CCID/openpgp_lib/ccid_openpgp_object.c
    ../../CCID/openpgp_lib/ccid_openpgp_pin.c
    ../../CCID/openpgp_lib/ccid_pin_auth.c
    ../../CCID/oath_lib/ccid_oath.c
    ../../CCID/oath_lib/ccid_oath_account.c
    ../../CCID/oath_lib/ccid_oath_calculate.c
    ../../CCID/oath_lib/ccid_oath_list.c
    ../../CCID/oath_lib/ccid_oath_object.c
    ../../CCID/oath_lib/ccid_oath_totp.c
    ../../TFT/tiny_tft_lib/tiny_tft.c
    ../../TFT/tiny_tft_lib/tiny_tft_const.c
)
target_include_directories(app PRIVATE 
    $ENV{NCS_HOME}/modules/lib/tinycbor/include
    $ENV{ZEPHYR_BASE}/subsys/settings/include
    include
    ../../FIDO2Device/ctap2_lib
    ../../FIDO2Device/fido2_lib
    ../../FIDO2Device/u2f_lib
    ../../FIDO2Device/wrapper_header
    ../../CCID/ccid_lib
    ../../CCID/oath_lib
    ../../CCID/openpgp_lib
    ../../CCID/piv_lib
    ../../TFT/tiny_tft_lib
)
```

## Kconfig
```
# Copyright (c) 2021 Nordic Semiconductor ASA
# SPDX-License-Identifier: Apache-2.0
#
# Application settings
#
config APP_FW_BUILD
	int "Firmware build revision serial number"
	default 100
	help
	  Serial number of application firmware build revision

config APP_SETTINGS_BUFFER_SIZE
	int "Read buffer size for app_settings"
	default 128
	depends on SETTINGS && SETTINGS_NVS
	help
	  Size of buffer for reading data from NVS

config APP_SETTINGS_THREAD_STACK_SIZE
	int "Stack size for application thread"
	default 2048
	help
	  Size of stack area used by application thread

config APP_SETTINGS_THREAD_PRIORITY
	int "Priority for application thread"
	default 7
	help
	  Number of scheduling priority used by application thread

config APP_SETTINGS_GENERATE_RSA2048_KEYPAIR
	bool "Generate RSA-2048 new keypair"
	default n
	help
	  Enables generating RSA-2048 new keypair

#
# Enable external RTCC
#
config USE_EXTERNAL_RTCC
	bool "Use external RTCC"
	default n
	depends on I2C
	help
	  Enables using of RV-3028-C7 as external RTCC

#
# Enable tiny TFT display
#
config USE_TINY_TFT
	bool "Use external tiny TFT display"
	default n
	depends on SPI
	help
	  Enables using of KWH009ST01-F01 as external TFT display

#
# Enable ATECC608A
#
config USE_ATECC608A
	bool "Use ATECC608A"
	default n
	help
	  Enables using of ATECC608A as EC crypto hardware

source "Kconfig.zephyr"
```

## prj.conf
```kconfig
#
# for firmware revision control
#
CONFIG_APP_FW_BUILD=110

#
# for Bluetooth peripheral
#
CONFIG_BT=y
CONFIG_BT_PERIPHERAL=y
CONFIG_BT_GATT_DYNAMIC_DB=y
CONFIG_BT_LIM_ADV_TIMEOUT=90
CONFIG_BT_L2CAP_TX_MTU=126
CONFIG_BT_BUF_ACL_RX_SIZE=128
CONFIG_BT_MAX_CONN=1
CONFIG_BT_MAX_PAIRED=10
CONFIG_BT_SETTINGS=y

#
# for Bluetooth SMP
#
CONFIG_BT_SMP=y
CONFIG_BT_SMP_SC_ONLY=y
CONFIG_BT_SMP_APP_PAIRING_ACCEPT=y
CONFIG_BT_FIXED_PASSKEY=y
CONFIG_BT_TINYCRYPT_ECC=y

#
# for Device Information Service
#
CONFIG_BT_DIS=y
CONFIG_BT_DIS_SETTINGS=y
CONFIG_BT_DIS_STR_MAX=21
CONFIG_BT_DIS_PNP=n
CONFIG_BT_DIS_MODEL="Secure device"
CONFIG_BT_DIS_MANUF="Diverta Inc."
CONFIG_BT_DIS_SERIAL_NUMBER=n
CONFIG_BT_DIS_FW_REV=n
CONFIG_BT_DIS_HW_REV=n
CONFIG_BT_DIS_SW_REV=n
CONFIG_BT_DIS_SERIAL_NUMBER_STR=""
CONFIG_BT_DIS_FW_REV_STR=""
CONFIG_BT_DIS_HW_REV_STR=""
CONFIG_BT_DIS_SW_REV_STR=""

CONFIG_BT_DEVICE_NAME="Secure device"

#
# for USB
#
CONFIG_USB_DEVICE_STACK=y
CONFIG_USB_DEVICE_HID=y
CONFIG_USB_DEVICE_BOS=y
CONFIG_USB_DEVICE_OS_DESC=y
CONFIG_USB_DEVICE_VID=0xf055
CONFIG_USB_DEVICE_PID=0x0001
CONFIG_USB_DEVICE_MANUFACTURER="Diverta Inc."
CONFIG_USB_DEVICE_PRODUCT="Secure Dongle"
CONFIG_USB_DEVICE_SN="000000000000"
CONFIG_USB_DRIVER_LOG_LEVEL_OFF=y
CONFIG_USB_DEVICE_LOG_LEVEL_OFF=y

#
# for USB HID I/F
#
CONFIG_ENABLE_HID_INT_OUT_EP=y
CONFIG_HID_INTERRUPT_EP_MPS=64
CONFIG_USB_HID_POLL_INTERVAL_MS=10
CONFIG_USB_HID_BOOT_PROTOCOL=n
CONFIG_USB_HID_LOG_LEVEL_OFF=y

#
# for Button and LEDs
#
CONFIG_GPIO=y

#
# for Flash ROM
#
CONFIG_FLASH=y
CONFIG_FLASH_MAP=y
CONFIG_FLASH_PAGE_LAYOUT=y
CONFIG_FLASH_LOG_LEVEL_OFF=y

# enable Non-volatile Storage in flash
CONFIG_NVS=y
CONFIG_NVS_LOG_LEVEL_OFF=y

# enable user data setting
CONFIG_SETTINGS=y
CONFIG_SETTINGS_LOG_LEVEL_OFF=y
CONFIG_PM_PARTITION_SIZE_SETTINGS_STORAGE=0x4000
CONFIG_APP_SETTINGS_BUFFER_SIZE=1024

#
# for deep sleep
#
CONFIG_PM=y
CONFIG_PM_DEVICE=y

#
# for timer
#
CONFIG_COUNTER=y
CONFIG_COUNTER_RTC0=y

#
# for crypto
#
CONFIG_NORDIC_SECURITY_BACKEND=y
CONFIG_NRF_SECURITY_RNG=y
CONFIG_ENTROPY_GENERATOR=y

CONFIG_MBEDTLS=y
CONFIG_MBEDTLS_LIBRARY=y
CONFIG_MBEDTLS_ENABLE_HEAP=y
CONFIG_MBEDTLS_HEAP_SIZE=65536
CONFIG_MBEDTLS_INSTALL_PATH="DUMMY"
CONFIG_MBEDTLS_CTR_DRBG_C=y
CONFIG_PSA_WANT_ALG_CTR_DRBG=y

# Disable unneeded crypto operations
CONFIG_MBEDTLS_SHA384_C=n
CONFIG_MBEDTLS_SHA512_C=n
CONFIG_MBEDTLS_CIPHER_MODE_XTS=n
CONFIG_MBEDTLS_CHACHA20_C=n
CONFIG_MBEDTLS_POLY1305_C=n
CONFIG_MBEDTLS_CHACHAPOLY_C=n
CONFIG_MBEDTLS_GCM_C=n
CONFIG_MBEDTLS_PSA_CRYPTO_C=n

CONFIG_TINYCBOR=y
CONFIG_ZCBOR=n
#
# for compiler option
#
CONFIG_COMPILER_OPT="-DFIDO_ZEPHYR -DMBEDTLS_DES_C -DMBEDTLS_ECP_RESTARTABLE"

#
# for debug
#
CONFIG_BT_DEBUG_LOG=n
CONFIG_BT_DEBUG_NONE=n
CONFIG_BT_DEBUG_SMP=n

#
# for system
#
CONFIG_RESET_ON_FATAL_ERROR=n
```

## overlay-smp.conf
```kconfig
#
# contents from smp_svr/prj.conf
#
# Enable mcumgr.
CONFIG_MCUMGR=y

# Ensure an MCUboot-compatible binary is generated.
CONFIG_BOOTLOADER_MCUBOOT=y

# Enable flash operations.
CONFIG_FLASH=y

# Required by the `taskstat` command.
CONFIG_THREAD_MONITOR=y

# Support for taskstat command
CONFIG_OS_MGMT_TASKSTAT=y

# Enable statistics and statistic names.
CONFIG_STATS=n
CONFIG_STATS_NAMES=n

# Enable most core commands.
CONFIG_MCUMGR_CMD_IMG_MGMT=y
CONFIG_MCUMGR_CMD_OS_MGMT=y
CONFIG_MCUMGR_CMD_STAT_MGMT=n

# Enable logging
CONFIG_LOG=y
CONFIG_MCUBOOT_UTIL_LOG_LEVEL_WRN=y

#
# contents from smp_svr/overlay-bt.conf
#
# Allow for large Bluetooth data packets.
CONFIG_BT_L2CAP_TX_MTU=498
CONFIG_BT_BUF_ACL_RX_SIZE=502
CONFIG_BT_BUF_ACL_TX_SIZE=502
CONFIG_BT_CTLR_DATA_LENGTH_MAX=251

# Enable the Bluetooth (unauthenticated) and shell mcumgr transports.
CONFIG_MCUMGR_SMP_BT=y
CONFIG_MCUMGR_SMP_BT_AUTHEN=y
CONFIG_MCUMGR_SMP_BT_CONN_PARAM_CONTROL=y
CONFIG_MCUMGR_SMP_SHELL=n

# Enable the mcumgr Packet Reassembly feature over Bluetooth and its configuration dependencies.
# MCUmgr buffer size is optimized to fit one SMP packet divided into five Bluetooth Write Commands,
# transmitted with the maximum possible MTU value: 498 bytes.
CONFIG_MCUMGR_SMP_REASSEMBLY_BT=y
CONFIG_MCUMGR_BUF_SIZE=2475
CONFIG_OS_MGMT_MCUMGR_PARAMS=y
CONFIG_MCUMGR_SMP_WORKQUEUE_STACK_SIZE=4608

# Enable the LittleFS file system.
CONFIG_FILE_SYSTEM=n
CONFIG_FILE_SYSTEM_LITTLEFS=n

# Add 256 bytes to accommodate upload command (lfs_stat overflows)
CONFIG_SYSTEM_WORKQUEUE_STACK_SIZE=2304

# Enable file system commands
CONFIG_MCUMGR_CMD_FS_MGMT=n

# Enable the storage erase command.
CONFIG_MCUMGR_GRP_ZEPHYR_BASIC=y
CONFIG_MCUMGR_GRP_BASIC_CMD_STORAGE_ERASE=y

# Disable Bluetooth ping support
CONFIG_BT_CTLR_LE_PING=n

# Disable shell commands that are not needed
CONFIG_CLOCK_CONTROL_NRF_SHELL=n
CONFIG_DEVICE_SHELL=n
CONFIG_DEVMEM_SHELL=n
CONFIG_FLASH_SHELL=n
```

## overlay-usb-dfu.conf
```kconfig
#
# for USB DFU I/F
#
# Enable support for managing DFU image.
CONFIG_IMG_MANAGER=y

# Some command handlers require a large stack.
CONFIG_SYSTEM_WORKQUEUE_STACK_SIZE=2048

# Ensure an MCUboot-compatible binary is generated.
CONFIG_BOOTLOADER_MCUBOOT=y

# Enable logging
CONFIG_LOG=y
CONFIG_MCUBOOT_UTIL_LOG_LEVEL_WRN=y
```

## boards/nrf52840dk_nrf52840.conf
```kconfig
#
# for Device Information Service
#
#   PCA10059    : nRF52840 DK
#   PCA10059_01 : MDBT50Q dongle(rev2)
#
CONFIG_BT_DIS_FW_REV=y
CONFIG_BT_DIS_HW_REV=y
CONFIG_BT_DIS_FW_REV_STR="0.4.1"
CONFIG_BT_DIS_HW_REV_STR="PCA10059_01"
CONFIG_BT_DEVICE_NAME="Secure dongle 52"

#
# for system
#
CONFIG_HEAP_MEM_POOL_SIZE=1024
```

## boards/nrf5340dk_nrf5340_cpuapp.conf
```kconfig
#
# for Device Information Service
#
#   PCA10095    : nRF5340 DK
#   PCA10095_01 : nRF5340 DK with i2c RTCC
#
CONFIG_BT_DIS_FW_REV=y
CONFIG_BT_DIS_HW_REV=y
CONFIG_BT_DIS_FW_REV_STR="0.4.8"
CONFIG_BT_DIS_HW_REV_STR="PCA10095_01"
CONFIG_BT_DEVICE_NAME="Secure device 53"

#
# for system
#
CONFIG_HEAP_MEM_POOL_SIZE=4096

#
# for I2C external RTCC
#
CONFIG_I2C=n
CONFIG_USE_EXTERNAL_RTCC=n

#
# for SPI external TFT display
#
CONFIG_SPI=n
CONFIG_USE_TINY_TFT=n
```

## src/main.c
```c
/* main.c - Application main entry point */

/*
 * Copyright (c) 2015-2016 Intel Corporation
 *
 * SPDX-License-Identifier: Apache-2.0
 */
#ifdef ORIGINAL_SOURCE
#include <zephyr/types.h>
#include <stddef.h>
#include <string.h>
#include <errno.h>
#include <zephyr/sys/printk.h>
#include <zephyr/sys/byteorder.h>
#include <zephyr/kernel.h>

#include <zephyr/bluetooth/bluetooth.h>
#include <zephyr/bluetooth/hci.h>
#include <zephyr/bluetooth/conn.h>
#include <zephyr/bluetooth/uuid.h>
#include <zephyr/bluetooth/gatt.h>
#include <zephyr/settings/settings.h>

#else
#include "app_main.h"
#endif

#ifdef ORIGINAL_SOURCE
static const struct bt_data ad[] = {
	BT_DATA_BYTES(BT_DATA_FLAGS, (BT_LE_AD_GENERAL | BT_LE_AD_NO_BREDR)),
	BT_DATA_BYTES(BT_DATA_UUID16_ALL, BT_UUID_16_ENCODE(BT_UUID_DIS_VAL)),
};

static void connected(struct bt_conn *conn, uint8_t err)
{
	if (err) {
		printk("Connection failed (err 0x%02x)\n", err);
	} else {
		printk("Connected\n");
	}
}

static void disconnected(struct bt_conn *conn, uint8_t reason)
{
	printk("Disconnected (reason 0x%02x)\n", reason);
}

BT_CONN_CB_DEFINE(conn_callbacks) = {
	.connected = connected,
	.disconnected = disconnected,
};

static int settings_runtime_load(void)
{
#if defined(CONFIG_BT_DIS_SETTINGS)
	settings_runtime_set("bt/dis/model",
			     "Zephyr Model",
			     sizeof("Zephyr Model"));
	settings_runtime_set("bt/dis/manuf",
			     "Zephyr Manufacturer",
			     sizeof("Zephyr Manufacturer"));
#if defined(CONFIG_BT_DIS_SERIAL_NUMBER)
	settings_runtime_set("bt/dis/serial",
			     CONFIG_BT_DIS_SERIAL_NUMBER_STR,
			     sizeof(CONFIG_BT_DIS_SERIAL_NUMBER_STR));
#endif
#if defined(CONFIG_BT_DIS_SW_REV)
	settings_runtime_set("bt/dis/sw",
			     CONFIG_BT_DIS_SW_REV_STR,
			     sizeof(CONFIG_BT_DIS_SW_REV_STR));
#endif
#if defined(CONFIG_BT_DIS_FW_REV)
	settings_runtime_set("bt/dis/fw",
			     CONFIG_BT_DIS_FW_REV_STR,
			     sizeof(CONFIG_BT_DIS_FW_REV_STR));
#endif
#if defined(CONFIG_BT_DIS_HW_REV)
	settings_runtime_set("bt/dis/hw",
			     CONFIG_BT_DIS_HW_REV_STR,
			     sizeof(CONFIG_BT_DIS_HW_REV_STR));
#endif
#endif
	return 0;
}
#endif

void main(void)
{
#ifdef ORIGINAL_SOURCE
	int err;

	err = bt_enable(NULL);
	if (err) {
		printk("Bluetooth init failed (err %d)\n", err);
		return;
	}

	if (IS_ENABLED(CONFIG_BT_SETTINGS)) {
		settings_load();
	}

	settings_runtime_load();

	printk("Bluetooth initialized\n");

	err = bt_le_adv_start(BT_LE_ADV_CONN_NAME, ad, ARRAY_SIZE(ad), NULL, 0);
	if (err) {
		printk("Advertising failed to start (err %d)\n", err);
		return;
	}

	printk("Advertising successfully started\n");
#else
        app_main_init();
#endif
}
```

## include/app_ble_advertise.h
```c
/* 
 * File:   app_ble_advertise.h
 * Author: makmorit
 *
 * Created on 2023/04/24, 11:05
 */
#ifndef APP_BLE_ADVERTISE_H
#define APP_BLE_ADVERTISE_H

#include <stdbool.h>

#ifdef __cplusplus
extern "C" {
#endif

//
// 関数群
//
bool        app_ble_advertise_is_available(void);
bool        app_ble_advertise_is_stopped(void);
void        app_ble_advertise_init(void);
void        app_ble_advertise_start(void);
void        app_ble_advertise_stop(void);

#ifdef __cplusplus
}
#endif

#endif /* APP_BLE_ADVERTISE_H */
```

## include/app_ble_connection.h
```c
/* 
 * File:   app_ble_connection.h
 * Author: makmorit
 *
 * Created on 2023/04/24, 16:58
 */
#ifndef APP_BLE_CONNECTION_H
#define APP_BLE_CONNECTION_H

#ifdef __cplusplus
extern "C" {
#endif

//
// 関数群
//
void       *app_ble_connection_address_get(void);

#ifdef __cplusplus
}
#endif

#endif /* APP_BLE_CONNECTION_H */
```

## include/app_ble_define.h
```c
/* 
 * File:   app_ble_define.h
 * Author: makmorit
 *
 * Created on 2023/04/20, 10:30
 */
#ifndef APP_BLE_DEFINE_H
#define APP_BLE_DEFINE_H

#ifdef __cplusplus
extern "C" {
#endif

#define PEER_ID_NOT_EXIST 0xffff

#ifdef __cplusplus
}
#endif

#endif /* APP_BLE_DEFINE_H */
```

## include/app_ble_fido.h
```c
/* 
 * File:   app_ble_fido.h
 * Author: makmorit
 *
 * Created on 2021/08/26, 11:50
 */
#ifndef APP_BLE_FIDO_H
#define APP_BLE_FIDO_H

#include <stdbool.h>
#include <stdint.h>
#include <zephyr/bluetooth/uuid.h>

#ifdef __cplusplus
extern "C" {
#endif

//
// サービス／キャラクタリスティックのUUID
//
// FIDO BLE Service                     FFFD
// FIDO U2F Control Point(RX)           F1D0FFF1-DEAA-ECEE-B42F-C9BA7ED623BB
// FIDO U2F Control Point Length        F1D0FFF3-DEAA-ECEE-B42F-C9BA7ED623BB
// FIDO U2F Status(TX)                  F1D0FFF2-DEAA-ECEE-B42F-C9BA7ED623BB
// FIDO U2F Service Revision Bitfield   F1D0FFF4-DEAA-ECEE-B42F-C9BA7ED623BB
// FIDO U2F Service Revision            2A28
//
#define BT_UUID_FIDO_VAL 0xfffd

#define BT_UUID_FIDO_RX_VAL \
        BT_UUID_128_ENCODE(0xf1d0fff1, 0xdeaa, 0xecee, 0xb42f, 0xc9ba7ed623bb)

#define BT_UUID_FIDO_RX_LEN_VAL \
        BT_UUID_128_ENCODE(0xf1d0fff3, 0xdeaa, 0xecee, 0xb42f, 0xc9ba7ed623bb)

#define BT_UUID_FIDO_TX_VAL \
        BT_UUID_128_ENCODE(0xf1d0fff2, 0xdeaa, 0xecee, 0xb42f, 0xc9ba7ed623bb)

#define BT_UUID_FIDO_SERVICE_REVBF_VAL \
        BT_UUID_128_ENCODE(0xf1d0fff4, 0xdeaa, 0xecee, 0xb42f, 0xc9ba7ed623bb)

#define BT_UUID_FIDO_SERVICE_REV_VAL 0x2a28

#define BT_UUID_FIDO_SERVICE        BT_UUID_DECLARE_16(BT_UUID_FIDO_VAL)
#define BT_UUID_FIDO_RX             BT_UUID_DECLARE_128(BT_UUID_FIDO_RX_VAL)
#define BT_UUID_FIDO_RX_LEN         BT_UUID_DECLARE_128(BT_UUID_FIDO_RX_LEN_VAL)
#define BT_UUID_FIDO_TX             BT_UUID_DECLARE_128(BT_UUID_FIDO_TX_VAL)
#define BT_UUID_FIDO_SERVICE_REVBF  BT_UUID_DECLARE_128(BT_UUID_FIDO_SERVICE_REVBF_VAL)
#define BT_UUID_FIDO_SERVICE_REV    BT_UUID_DECLARE_16(BT_UUID_FIDO_SERVICE_REV_VAL)

//
// 関数群
//
bool        app_ble_fido_send_data(const uint8_t *data, uint16_t len);
bool        app_ble_fido_connected(void);

#ifdef __cplusplus
}
#endif

#endif /* APP_BLE_FIDO_H */
```

## include/app_ble_init.h
```c
/* 
 * File:   app_ble_init.h
 * Author: makmorit
 *
 * Created on 2021/04/06, 14:50
 */
#ifndef APP_BLUETOOTH_H
#define APP_BLUETOOTH_H

#ifdef __cplusplus
extern "C" {
#endif

//
// 関数群
//
void        app_ble_init(void);

#ifdef __cplusplus
}
#endif

#endif /* APP_BLUETOOTH_H */
```

## include/app_ble_pairing.h
```c
/* 
 * File:   app_ble_pairing.h
 * Author: makmorit
 *
 * Created on 2021/04/27, 10:18
 */
#ifndef APP_BLE_PAIRING_H
#define APP_BLE_PAIRING_H

#include <stdbool.h>
#include <stdint.h>

#ifdef __cplusplus
extern "C" {
#endif

//
// 関数群
//
uint8_t     app_ble_pairing_get_peer_count(void);
bool        app_ble_pairing_mode_set(bool b);
bool        app_ble_pairing_mode(void);
void        app_ble_pairing_mode_initialize(void);
bool        app_ble_pairing_register_callbacks(void);

#ifdef __cplusplus
}
#endif

#endif /* APP_BLE_PAIRING_H */
```

## include/app_ble_smp.h
```c
/* 
 * File:   app_ble_smp.h
 * Author: makmorit
 *
 * Created on 2021/08/09, 14:59
 */
#ifndef APP_BLE_SMP_H
#define APP_BLE_SMP_H

#include <stdbool.h>

#ifdef __cplusplus
extern "C" {
#endif

//
// 関数群
//
void        app_ble_smp_register_group(void);
void        app_ble_smp_bt_register(void);

#ifdef __cplusplus
}
#endif

#endif /* APP_BLE_SMP_H */
```

## include/app_ble_unpairing.h
```c
/* 
 * File:   app_ble_unpairing.h
 * Author: makmorit
 *
 * Created on 2023/04/20, 10:16
 */
#ifndef APP_BLE_UNPAIRING_H
#define APP_BLE_UNPAIRING_H

#include <stdbool.h>
#include <stdint.h>

#ifdef __cplusplus
extern "C" {
#endif

//
// 関数群
//
bool        app_ble_unpairing_get_peer_id(uint16_t *peer_id_to_unpair);
bool        app_ble_unpairing_delete_peer_id(uint16_t peer_id_to_unpair);
bool        app_ble_unpairing_delete_all_peers(void (*response_func)(bool));

#ifdef __cplusplus
}
#endif

#endif /* APP_BLE_UNPAIRING_H */
```

## include/app_bluetooth.h
```c
/* 
 * File:   app_bluetooth.h
 * Author: makmorit
 *
 * Created on 2021/04/06, 14:50
 */
#ifndef APP_BLUETOOTH_H
#define APP_BLUETOOTH_H

#ifdef __cplusplus
extern "C" {
#endif

//
// 関数群
//
void        app_bluetooth_start(void);

#ifdef __cplusplus
}
#endif

#endif /* APP_BLUETOOTH_H */
```

## include/app_board.h
```c
/* 
 * File:   app_board.h
 * Author: makmorit
 *
 * Created on 2021/04/02, 16:25
 */
#ifndef APP_BOARD_H
#define APP_BOARD_H

#include <stdint.h>
#include <stdbool.h>
#include <stddef.h>

#ifdef __cplusplus
extern "C" {
#endif

// LED種別
typedef enum _LED_COLOR {
    LED_COLOR_NONE = 0,
    LED_COLOR_RED,
    LED_COLOR_GREEN,
    LED_COLOR_BLUE,
    LED_COLOR_YELLOW
} LED_COLOR;

//
// 関数群
//
uint32_t    app_board_kernel_uptime_ms_get(void);
bool        app_board_get_version_info_csv(uint8_t *info_csv_data, size_t *info_csv_size);
void        app_board_button_press_enable(bool b);
void        app_board_initialize(void);
void        app_board_led_light(LED_COLOR led_color, bool led_on);
void        app_board_prepare_for_deep_sleep(void);
void        app_board_prepare_for_system_reset(void);
void        app_board_prepare_for_bootloader_mode(void);

#ifdef __cplusplus
}
#endif

#endif /* APP_BOARD_H */
```

## include/app_board_define.h
```c
/* 
 * File:   app_board_define.h
 * Author: makmorit
 *
 * Created on 2021/04/05, 11:14
 */
#ifndef APP_BOARD_DEFINE_H
#define APP_BOARD_DEFINE_H

#include <zephyr/drivers/gpio.h>

#ifdef __cplusplus
extern "C" {
#endif

//
// LED関連
//
#define LED0_NODE	DT_ALIAS(led0)
#define LED0_GPIO_LABEL	DT_GPIO_LABEL(LED0_NODE, gpios)
#define LED0_GPIO_PIN	DT_GPIO_PIN(LED0_NODE, gpios)
#define LED0_GPIO_FLAGS	(GPIO_OUTPUT | DT_GPIO_FLAGS(LED0_NODE, gpios))

#define LED1_NODE	DT_ALIAS(led1)
#define LED1_GPIO_LABEL	DT_GPIO_LABEL(LED1_NODE, gpios)
#define LED1_GPIO_PIN	DT_GPIO_PIN(LED1_NODE, gpios)
#define LED1_GPIO_FLAGS	(GPIO_OUTPUT | DT_GPIO_FLAGS(LED1_NODE, gpios))

#define LED2_NODE	DT_ALIAS(led2)
#define LED2_GPIO_LABEL	DT_GPIO_LABEL(LED2_NODE, gpios)
#define LED2_GPIO_PIN	DT_GPIO_PIN(LED2_NODE, gpios)
#define LED2_GPIO_FLAGS	(GPIO_OUTPUT | DT_GPIO_FLAGS(LED2_NODE, gpios))

#define LED3_NODE	DT_ALIAS(led3)
#define LED3_GPIO_LABEL	DT_GPIO_LABEL(LED3_NODE, gpios)
#define LED3_GPIO_PIN	DT_GPIO_PIN(LED3_NODE, gpios)
#define LED3_GPIO_FLAGS	(GPIO_OUTPUT | DT_GPIO_FLAGS(LED3_NODE, gpios))

#ifdef __cplusplus
}
#endif

#endif /* APP_BOARD_DEFINE_H */
```

## include/app_crypto.h
```c
/* 
 * File:   app_crypto.h
 * Author: makmorit
 *
 * Created on 2021/05/12, 9:59
 */
#ifndef APP_CRYPTO_H
#define APP_CRYPTO_H

#include <stdint.h>

#ifdef __cplusplus
extern "C" {
#endif

//
// 関数群
//
void       *app_crypto_ctr_drbg_context(void);
void        app_crypto_do_process(uint8_t event);

#ifdef __cplusplus
}
#endif

#endif /* APP_CRYPTO_H */
```
