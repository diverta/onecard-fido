## CMakeLists.txt
```
# SPDX-License-Identifier: Apache-2.0

cmake_minimum_required(VERSION 3.13.1)
find_package(Zephyr REQUIRED HINTS $ENV{ZEPHYR_BASE})
project(secure_device_app)

FILE(GLOB app_sources src/*.c)
target_sources(app PRIVATE
    ${app_sources}
    zephyr_custom/subsys/mgmt/mcumgr/smp_bt.c
)
target_include_directories(app PRIVATE 
    include
)
```

## prj.conf
```kconfig
#
# for Bluetooth peripheral
#
CONFIG_BT=y
CONFIG_BT_PERIPHERAL=y
CONFIG_BT_GATT_DYNAMIC_DB=y

#
# for Bluetooth SMP
#
CONFIG_BT_SMP=y
CONFIG_BT_SMP_SC_PAIR_ONLY=y
CONFIG_BT_TINYCRYPT_ECC=y

#
# for Device Information Service
#
CONFIG_BT_DIS=y
CONFIG_BT_DIS_SETTINGS=y
CONFIG_BT_DIS_STR_MAX=21
CONFIG_BT_DIS_PNP=n
CONFIG_BT_DIS_MODEL="Secure device"
CONFIG_BT_DIS_MANUF="Diverta Inc."
CONFIG_BT_DIS_SERIAL_NUMBER=n
CONFIG_BT_DIS_FW_REV=y
CONFIG_BT_DIS_HW_REV=n
CONFIG_BT_DIS_SW_REV=n
CONFIG_BT_DIS_SERIAL_NUMBER_STR=""
CONFIG_BT_DIS_FW_REV_STR="0.0.0"
CONFIG_BT_DIS_HW_REV_STR=""
CONFIG_BT_DIS_SW_REV_STR=""

CONFIG_BT_DEVICE_NAME="Secure device 53"

#
# for USB
#
CONFIG_USB=y
CONFIG_USB_DEVICE_STACK=y
CONFIG_USB_DEVICE_HID=y
CONFIG_USB_DEVICE_VID=0xf055
CONFIG_USB_DEVICE_PID=0x0001
CONFIG_USB_DEVICE_MANUFACTURER="Diverta Inc."
CONFIG_USB_DEVICE_PRODUCT="Secure Dongle"
CONFIG_USB_DEVICE_SN="000000000000"

#
# for USB HID I/F
#
CONFIG_ENABLE_HID_INT_OUT_EP=y
CONFIG_HID_INTERRUPT_EP_MPS=64
CONFIG_USB_HID_POLL_INTERVAL_MS=10
CONFIG_USB_HID_BOOT_PROTOCOL=n

#
# for Button and LEDs
#
CONFIG_GPIO=y

#
# for Flash ROM
#
CONFIG_FLASH=y
CONFIG_FLASH_MAP=y
CONFIG_FLASH_PAGE_LAYOUT=y
CONFIG_FLASH_LOG_LEVEL_DBG=n

# enable the LittleFS file system.
CONFIG_FILE_SYSTEM=y
CONFIG_FILE_SYSTEM_LITTLEFS=y

# for fs_dirent structures
CONFIG_MAIN_STACK_SIZE=2048

#
# for deep sleep
#
CONFIG_PM=y
CONFIG_PM_DEVICE=y

#
# for timer
#
CONFIG_COUNTER=y
CONFIG_COUNTER_RTC0=y

#
# for crypto
#
CONFIG_NORDIC_SECURITY_BACKEND=y
CONFIG_NRF_SECURITY_RNG=y
CONFIG_ENTROPY_GENERATOR=y

CONFIG_MBEDTLS=y
CONFIG_MBEDTLS_LIBRARY=y
CONFIG_MBEDTLS_ENABLE_HEAP=y
CONFIG_MBEDTLS_HEAP_SIZE=65536
CONFIG_MBEDTLS_INSTALL_PATH="DUMMY"

#
# for compiler option
#
CONFIG_COMPILER_OPT="-DMBEDTLS_DES_C"

#
# for debug
#
CONFIG_BT_DEBUG_LOG=n
CONFIG_BT_DEBUG_NONE=n
CONFIG_BT_DEBUG_SMP=n
```

## overlay-smp.conf
```kconfig
#
# contents from smp_svr/prj.conf
#
# Enable mcumgr.
CONFIG_MCUMGR=y

# Some command handlers require a large stack.
CONFIG_SYSTEM_WORKQUEUE_STACK_SIZE=2048

# Ensure an MCUboot-compatible binary is generated.
CONFIG_BOOTLOADER_MCUBOOT=y

# Required by the `taskstat` command.
CONFIG_THREAD_MONITOR=y

# Enable statistics and statistic names.
CONFIG_STATS=n
CONFIG_STATS_NAMES=n

# Enable most core commands.
CONFIG_MCUMGR_CMD_IMG_MGMT=y
CONFIG_MCUMGR_CMD_OS_MGMT=y
CONFIG_MCUMGR_CMD_STAT_MGMT=n

# Enable logging
CONFIG_LOG=y
CONFIG_MCUBOOT_UTIL_LOG_LEVEL_WRN=y

#
# contents from smp_svr/overlay-bt.conf
#
# Allow for large Bluetooth data packets.
CONFIG_BT_L2CAP_TX_MTU=252
CONFIG_BT_L2CAP_RX_MTU=252
CONFIG_BT_RX_BUF_LEN=260

# Enable the Bluetooth (unauthenticated) and shell mcumgr transports.
CONFIG_MCUMGR_SMP_BT=n
CONFIG_MCUMGR_SMP_BT_AUTHEN=n
CONFIG_MCUMGR_SMP_SHELL=n

# Add 256 bytes to accommodate upload command (lfs_stat overflows)
CONFIG_SYSTEM_WORKQUEUE_STACK_SIZE=2304

# Enable file system commands
CONFIG_MCUMGR_CMD_FS_MGMT=n
```

## src/main.c
```c
/* main.c - Application main entry point */

/*
 * Copyright (c) 2015-2016 Intel Corporation
 *
 * SPDX-License-Identifier: Apache-2.0
 */

#include <zephyr/types.h>
#include <stddef.h>
#include <string.h>
#include <errno.h>
#include <sys/printk.h>
#include <sys/byteorder.h>
#include <zephyr.h>

#include <bluetooth/bluetooth.h>
#include <bluetooth/hci.h>
#include <bluetooth/conn.h>
#include <bluetooth/uuid.h>
#include <bluetooth/gatt.h>
#include <settings/settings.h>

#include "app_main.h"

#ifdef ORIGINAL_SOURCE
static const struct bt_data ad[] = {
	BT_DATA_BYTES(BT_DATA_FLAGS, (BT_LE_AD_GENERAL | BT_LE_AD_NO_BREDR)),
	BT_DATA_BYTES(BT_DATA_UUID16_ALL, BT_UUID_16_ENCODE(BT_UUID_DIS_VAL)),
};

static void connected(struct bt_conn *conn, uint8_t err)
{
	if (err) {
		printk("Connection failed (err 0x%02x)\n", err);
	} else {
		printk("Connected\n");
	}
}

static void disconnected(struct bt_conn *conn, uint8_t reason)
{
	printk("Disconnected (reason 0x%02x)\n", reason);
}

static struct bt_conn_cb conn_callbacks = {
	.connected = connected,
	.disconnected = disconnected,
};

static int settings_runtime_load(void)
{
#if defined(CONFIG_BT_DIS_SETTINGS)
	settings_runtime_set("bt/dis/model",
			     "Zephyr Model",
			     sizeof("Zephyr Model"));
	settings_runtime_set("bt/dis/manuf",
			     "Zephyr Manufacturer",
			     sizeof("Zephyr Manufacturer"));
#if defined(CONFIG_BT_DIS_SERIAL_NUMBER)
	settings_runtime_set("bt/dis/serial",
			     CONFIG_BT_DIS_SERIAL_NUMBER_STR,
			     sizeof(CONFIG_BT_DIS_SERIAL_NUMBER_STR));
#endif
#if defined(CONFIG_BT_DIS_SW_REV)
	settings_runtime_set("bt/dis/sw",
			     CONFIG_BT_DIS_SW_REV_STR,
			     sizeof(CONFIG_BT_DIS_SW_REV_STR));
#endif
#if defined(CONFIG_BT_DIS_FW_REV)
	settings_runtime_set("bt/dis/fw",
			     CONFIG_BT_DIS_FW_REV_STR,
			     sizeof(CONFIG_BT_DIS_FW_REV_STR));
#endif
#if defined(CONFIG_BT_DIS_HW_REV)
	settings_runtime_set("bt/dis/hw",
			     CONFIG_BT_DIS_HW_REV_STR,
			     sizeof(CONFIG_BT_DIS_HW_REV_STR));
#endif
#endif
	return 0;
}
#endif

void main(void)
{
#ifdef ORIGINAL_SOURCE
	int err;

	err = bt_enable(NULL);
	if (err) {
		printk("Bluetooth init failed (err %d)\n", err);
		return;
	}

	if (IS_ENABLED(CONFIG_BT_SETTINGS)) {
		settings_load();
	}

	settings_runtime_load();

	printk("Bluetooth initialized\n");

	bt_conn_cb_register(&conn_callbacks);

	err = bt_le_adv_start(BT_LE_ADV_CONN_NAME, ad, ARRAY_SIZE(ad), NULL, 0);
	if (err) {
		printk("Advertising failed to start (err %d)\n", err);
		return;
	}

	printk("Advertising successfully started\n");
#else
        app_main();
#endif
}
```

## include/app_bluetooth.h
```c
/* 
 * File:   app_bluetooth.h
 * Author: makmorit
 *
 * Created on 2021/04/06, 14:50
 */
#ifndef APP_BLUETOOTH_H
#define APP_BLUETOOTH_H

#include <stdbool.h>

#ifdef __cplusplus
extern "C" {
#endif

//
// 関数群
//
bool        app_ble_start_advertising(void);
void        app_bluetooth_start(void);

#ifdef __cplusplus
}
#endif

#endif /* APP_BLUETOOTH_H */
```

## include/app_board.h
```c
/* 
 * File:   app_board.h
 * Author: makmorit
 *
 * Created on 2021/04/02, 16:25
 */
#ifndef APP_BOARD_H
#define APP_BOARD_H

#include <stdint.h>
#include <stdbool.h>

#ifdef __cplusplus
extern "C" {
#endif

// LED種別
typedef enum _LED_COLOR {
    LED_COLOR_NONE = 0,
    LED_COLOR_RED,
    LED_COLOR_GREEN,
    LED_COLOR_BLUE,
    LED_COLOR_YELLOW
} LED_COLOR;

//
// 関数群
//
uint32_t    app_board_kernel_uptime_ms_get(void);
void        app_board_initialize(void);
void        app_board_led_light(LED_COLOR led_color, bool led_on);
void        app_board_prepare_for_deep_sleep(void);
void        app_board_prepare_for_system_reset(void);

#ifdef __cplusplus
}
#endif

#endif /* APP_BOARD_H */
```

## include/app_board_define.h
```c
/* 
 * File:   app_board_define.h
 * Author: makmorit
 *
 * Created on 2021/04/05, 11:14
 */
#ifndef APP_BOARD_DEFINE_H
#define APP_BOARD_DEFINE_H

#include <drivers/gpio.h>

#ifdef __cplusplus
extern "C" {
#endif

//
// ボタン関連
//
#define SW0_NODE	DT_ALIAS(sw0)
#define SW0_GPIO_LABEL	DT_GPIO_LABEL(SW0_NODE, gpios)
#define SW0_GPIO_PIN	DT_GPIO_PIN(SW0_NODE, gpios)
#define SW0_GPIO_FLAGS	(GPIO_INPUT | DT_GPIO_FLAGS(SW0_NODE, gpios))

#define SW1_NODE	DT_ALIAS(sw1)
#define SW1_GPIO_LABEL	DT_GPIO_LABEL(SW1_NODE, gpios)
#define SW1_GPIO_PIN	DT_GPIO_PIN(SW1_NODE, gpios)
#define SW1_GPIO_FLAGS	(GPIO_INPUT | DT_GPIO_FLAGS(SW1_NODE, gpios))

//
// LED関連
//
#define LED0_NODE	DT_ALIAS(led0)
#define LED0_GPIO_LABEL	DT_GPIO_LABEL(LED0_NODE, gpios)
#define LED0_GPIO_PIN	DT_GPIO_PIN(LED0_NODE, gpios)
#define LED0_GPIO_FLAGS	(GPIO_OUTPUT | DT_GPIO_FLAGS(LED0_NODE, gpios))

#define LED1_NODE	DT_ALIAS(led1)
#define LED1_GPIO_LABEL	DT_GPIO_LABEL(LED1_NODE, gpios)
#define LED1_GPIO_PIN	DT_GPIO_PIN(LED1_NODE, gpios)
#define LED1_GPIO_FLAGS	(GPIO_OUTPUT | DT_GPIO_FLAGS(LED1_NODE, gpios))

#define LED2_NODE	DT_ALIAS(led2)
#define LED2_GPIO_LABEL	DT_GPIO_LABEL(LED2_NODE, gpios)
#define LED2_GPIO_PIN	DT_GPIO_PIN(LED2_NODE, gpios)
#define LED2_GPIO_FLAGS	(GPIO_OUTPUT | DT_GPIO_FLAGS(LED2_NODE, gpios))

#define LED3_NODE	DT_ALIAS(led3)
#define LED3_GPIO_LABEL	DT_GPIO_LABEL(LED3_NODE, gpios)
#define LED3_GPIO_PIN	DT_GPIO_PIN(LED3_NODE, gpios)
#define LED3_GPIO_FLAGS	(GPIO_OUTPUT | DT_GPIO_FLAGS(LED3_NODE, gpios))

#ifdef __cplusplus
}
#endif

#endif /* APP_BOARD_DEFINE_H */
```

## include/app_crypto.h
```c
/* 
 * File:   app_crypto.h
 * Author: makmorit
 *
 * Created on 2021/05/12, 9:59
 */
#ifndef APP_CRYPTO_H
#define APP_CRYPTO_H

#include <stdbool.h>
#include <stddef.h>
#include <stdint.h>

#ifdef __cplusplus
extern "C" {
#endif

//
// 関数群
//
void       *app_crypto_ctr_drbg_context(void);
bool        app_crypto_aes_cbc_256_encrypt(uint8_t *p_key, uint8_t *p_plaintext, size_t plaintext_size, uint8_t *encrypted, size_t *encrypted_size);
bool        app_crypto_aes_cbc_256_decrypt(uint8_t *p_key, uint8_t *p_encrypted, size_t encrypted_size, uint8_t *decrypted, size_t *decrypted_size);
bool        app_crypto_generate_random_vector(uint8_t *vector_buf, size_t vector_size);
bool        app_crypto_generate_sha256_hash(uint8_t *data, size_t data_size, uint8_t *hash_digest);
bool        app_crypto_generate_hmac_sha256(uint8_t *key_data, size_t key_data_size, uint8_t *src_data, size_t src_data_size, uint8_t *src_data_2, size_t src_data_2_size, uint8_t *hash_digest);
bool        app_crypto_des3_ecb(const uint8_t *in, uint8_t *out, const uint8_t *key);

#ifdef __cplusplus
}
#endif

#endif /* APP_CRYPTO_H */
```

## include/app_crypto_define.h
```c
/* 
 * File:   app_crypto_define.h
 * Author: makmorit
 *
 * Created on 2021/05/17, 10:57
 */
#ifndef APP_CRYPTO_DEFINE_H
#define APP_CRYPTO_DEFINE_H

#ifdef __cplusplus
extern "C" {
#endif

#define AES_KEY_SIZE        32
#define AES_IV_SIZE         16
#define SHA256_HASH_SIZE    32
#define DES3_KEY_SIZE       24
#define DES3_CRYPTO_SIZE    8

#ifdef __cplusplus
}
#endif

#endif /* APP_CRYPTO_DEFINE_H */
```

## include/app_crypto_ec.h
```c
/* 
 * File:   app_crypto_ec.h
 * Author: makmorit
 *
 * Created on 2021/05/17, 12:06
 */
#ifndef APP_CRYPTO_EC_H
#define APP_CRYPTO_EC_H

#include <stdbool.h>
#include <stddef.h>
#include <stdint.h>

#ifdef __cplusplus
extern "C" {
#endif

//
// 関数群
//
bool        app_crypto_ec_dsa_sign(uint8_t *private_key_be, uint8_t const *hash_digest, size_t digest_size, uint8_t *signature);
bool        app_crypto_ec_dsa_verify(uint8_t *public_key_be, uint8_t const *hash_digest, size_t digest_size, uint8_t *signature);
bool        app_crypto_ec_keypair_generate(uint8_t *private_key_raw_data, uint8_t *public_key_raw_data);
bool        app_crypto_ec_calculate_ecdh(uint8_t *private_key_raw_data, uint8_t *public_key_raw_data, uint8_t *shared_sec_raw_data, size_t shared_sec_raw_data_size);

#ifdef __cplusplus
}
#endif

#endif /* APP_CRYPTO_EC_H */
```

## include/app_custom.h
```c
/* 
 * File:   app_custom.h
 * Author: makmorit
 *
 * Created on 2021/05/06, 9:53
 */
#ifndef APP_CUSTOM_H
#define APP_CUSTOM_H

#include <stdbool.h>
#include <stddef.h>
#include <stdint.h>

#ifdef __cplusplus
extern "C" {
#endif

//
// 関数群
//
void        app_main_hid_report_received(uint8_t *data, size_t size);
void        app_main_hid_report_sent(void);
void        app_main_ccid_data_received(uint8_t *data, size_t size);
void        app_main_button_pressed_short(void);
void        app_main_button_1_pressed(void);

#ifdef __cplusplus
}
#endif

#endif /* APP_CUSTOM_H */
```

## include/app_data_event.h
```c
/* 
 * File:   app_data_event.h
 * Author: makmorit
 *
 * Created on 2021/05/05, 15:37
 */
#ifndef APP_DATA_EVENT_H
#define APP_DATA_EVENT_H

#include <stdbool.h>
#include <stddef.h>
#include <stdint.h>

#ifdef __cplusplus
extern "C" {
#endif

// イベント種別
typedef enum {
    DATEVT_NONE = 0,
    DATEVT_HID_REPORT_RECEIVED,
    DATEVT_HID_REPORT_SENT,
} DATA_EVENT_T;

//
// 関数群
//
bool        app_data_event_notify(DATA_EVENT_T event, uint8_t *data, size_t data_size);

#ifdef __cplusplus
}
#endif

#endif /* APP_DATA_EVENT_H */
```

## include/app_data_process.h
```c
/* 
 * File:   app_data_process.h
 * Author: makmorit
 *
 * Created on 2021/05/05, 15:37
 */
#ifndef APP_DATA_PROCESS_H
#define APP_DATA_PROCESS_H

#include "app_data_event.h"

#ifdef __cplusplus
extern "C" {
#endif

//
// 関数群
//
void        app_data_process_for_event(DATA_EVENT_T event, uint8_t *data, size_t size);

#ifdef __cplusplus
}
#endif

#endif /* APP_DATA_PROCESS_H */
```

## include/app_event.h
```c
/* 
 * File:   app_event.h
 * Author: makmorit
 *
 * Created on 2021/04/06, 15:13
 */
#ifndef APP_EVENT_H
#define APP_EVENT_H

#include <stdbool.h>
#include <stddef.h>
#include <stdint.h>

#ifdef __cplusplus
extern "C" {
#endif

// イベント種別
typedef enum {
    APEVT_NONE = 0,
    APEVT_BUTTON_PUSHED,
    APEVT_BUTTON_PUSHED_LONG,
    APEVT_BUTTON_RELEASED,
    APEVT_USB_CONNECTED,
    APEVT_USB_CONFIGURED,
    APEVT_USB_DISCONNECTED,
    APEVT_BLE_ADVERTISE_STARTED,
    APEVT_BLE_ADVERTISE_STOPPED,
    APEVT_BLE_CONNECTED,
    APEVT_BLE_DISCONNECTED,
    APEVT_IDLING_DETECTED,
} APP_EVENT_T;

// データ関連イベント種別
typedef enum {
    DATEVT_NONE = 0,
    DATEVT_HID_REPORT_RECEIVED,
    DATEVT_HID_REPORT_SENT,
    DATEVT_CCID_DATA_RECEIVED,
} DATA_EVENT_T;

//
// 関数群
//
bool        app_event_notify(APP_EVENT_T event);
bool        app_event_notify_for_data(DATA_EVENT_T event, uint8_t *data, size_t data_size);

#ifdef __cplusplus
}
#endif

#endif /* APP_EVENT_H */
```

## include/app_main.h
```c
/* 
 * File:   app_main.h
 * Author: makmorit
 *
 * Created on 2021/04/02, 15:04
 */
#ifndef APP_MAIN_H
#define APP_MAIN_H

#include <stdbool.h>

#ifdef __cplusplus
extern "C" {
#endif

//
// 関数群
//
void    app_main_init(void);
bool    app_main_initialized(void);

#ifdef __cplusplus
}
#endif

#endif /* APP_MAIN_H */
```

## include/app_process.h
```c
/* 
 * File:   app_process.h
 * Author: makmorit
 *
 * Created on 2021/04/28, 10:22
 */
#ifndef APP_PROCESS_H
#define APP_PROCESS_H

#include "app_event.h"

#ifdef __cplusplus
extern "C" {
#endif

//
// 関数群
//
void        app_process_for_event(APP_EVENT_T event);
void        app_process_for_data_event(DATA_EVENT_T event, uint8_t *data, size_t size);

#ifdef __cplusplus
}
#endif

#endif /* APP_PROCESS_H */
```
