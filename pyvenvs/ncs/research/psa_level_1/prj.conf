## CMakeLists.txt
```
# SPDX-License-Identifier: Apache-2.0

cmake_minimum_required(VERSION 3.13.1)

find_package(Zephyr REQUIRED HINTS $ENV{ZEPHYR_BASE})

project(tfm_psa_level_1)

# Source files in this sample
FILE(GLOB app_sources src/*.c)
target_sources(app PRIVATE ${app_sources})
```

## prj.conf
```kconfig
CONFIG_LOG=y
CONFIG_LOG_RUNTIME_FILTERING=y
CONFIG_LOG_BUFFER_SIZE=2048
CONFIG_LOG_PROCESS_TRIGGER_THRESHOLD=0
CONFIG_LOG_DEFAULT_LEVEL=4

CONFIG_BUILD_WITH_TFM=y

# The Zephyr CMSIS emulation assumes that ticks are ms, currently
CONFIG_SYS_CLOCK_TICKS_PER_SEC=1000

CONFIG_MAIN_STACK_SIZE=4096
CONFIG_HEAP_MEM_POOL_SIZE=4096
```

## src/main.c
```c
/*
 * Copyright (c) 2019,2020 Linaro Limited
 *
 * SPDX-License-Identifier: Apache-2.0
 */
#if ORIGINAL_SOURCE
#include <zephyr.h>
#include <logging/log_ctrl.h>
#include <logging/log.h>

#include "tfm_ns_interface.h"
#include "psa_attestation.h"
#include "psa_crypto.h"
#include "util_app_cfg.h"
#include "util_app_log.h"
#include "util_sformat.h"

/** Declare a reference to the application logging interface. */
LOG_MODULE_DECLARE(app, CONFIG_LOG_DEFAULT_LEVEL);

/* Create an instance of the system config struct for the application. */
static struct cfg_data cfg;
#else
#include "app_main.h"
#endif

void main(void)
{
#if ORIGINAL_SOURCE
	/* Initialize the TFM NS interface */
	tfm_ns_interface_init();

	/* Initialise the logger subsys and dump the current buffer. */
	log_init();

	/* Load app config struct from secure storage (create if missing). */
	if (cfg_load_data(&cfg)) {
		LOG_ERR("Error loading/generating app config data in SS.");
	}

	/* Get the entity attestation token (requires ~1kB stack memory!). */
	att_test();

	/* Crypto tests */
	crp_test_rng();
	crp_test_sha256();

	/* Dump any queued log messages, and wait for system events. */
	while (1) {
		al_dump_log();
	}

	while (1) {

	}
#else
    app_main();
#endif
}
```

## src/app_main.c
```c
/* 
 * File:   app_main.c
 * Author: makmorit
 *
 * Created on 2021/04/21, 11:20
 */
#include <zephyr.h>
#include <logging/log_ctrl.h>
#include <logging/log.h>

#include "app_tfm_psa_its.h"
#include "app_tfm_psa_ps.h"

#define LOG_LEVEL LOG_LEVEL_DBG
LOG_MODULE_REGISTER(app_main);

// データ内容
static uint8_t m_ps_data[16] = {20,21,22,23,24,25,26,27,28,29,30,31,32,33,34,35};
static uint8_t m_its_data[16] = {0,1,2,3,4,5,6,7,8,9,10,11,12,13,14,15};

void research_secure_storage(void)
{
    // 一時変数
    size_t record_size;
    bool   is_exist;

    // Protected Storage
    if (app_tfm_psa_ps_data_read(PSA_PS_TEST_RECORD_KEY, m_ps_data, &record_size, &is_exist) == false) {
        return;
    }
    if (is_exist) {
        LOG_INF("Protected Storage: exist");
        LOG_HEXDUMP_DBG(m_ps_data, record_size, "m_ps_data");
    } else {
        record_size = sizeof(m_ps_data);
        if (app_tfm_psa_ps_data_write(PSA_PS_TEST_RECORD_KEY, m_ps_data, record_size) == false) {
            return;
        }
        LOG_INF("Protected Storage: created");
    }

    // Internal Trusted Storage
    if (app_tfm_psa_its_data_read(PSA_ITS_TEST_RECORD_KEY, m_its_data, &record_size, &is_exist) == false) {
        return;
    }
    if (is_exist) {
        LOG_INF("Internal Trusted Storage: exist");
        LOG_HEXDUMP_DBG(m_its_data, record_size, "m_its_data");
    } else {
        record_size = sizeof(m_its_data);
        if (app_tfm_psa_its_data_write(PSA_ITS_TEST_RECORD_KEY, m_its_data, record_size) == false) {
            return;
        }
        LOG_INF("Internal Trusted Storage: created");
    }

    LOG_INF("research terminated.");
}

void app_main(void)
{
    // 調査用
    research_secure_storage();
}
```

## src/app_main.h
```c
/* 
 * File:   app_main.h
 * Author: makmorit
 *
 * Created on 2021/04/21, 11:20
 */
#ifndef APP_MAIN_H
#define APP_MAIN_H

#ifdef __cplusplus
extern "C" {
#endif

void        app_main(void);

#ifdef __cplusplus
}
#endif

#endif /* APP_MAIN_H */
```

## src/app_tfm_ns_interface.c
```c
/* 
 * File:   app_tfm_ns_interface.c
 * Author: makmorit
 *
 * Created on 2021/04/21, 11:20
 */
#include <zephyr.h>

#include "tfm_api.h"
#include "tfm_ns_interface.h"

K_MUTEX_DEFINE(tfm_mutex);

int32_t tfm_ns_interface_dispatch(veneer_fn fn, uint32_t arg0, uint32_t arg1, uint32_t arg2, uint32_t arg3)
{
    // TFM request protected by NS lock
    if (k_mutex_lock(&tfm_mutex, K_FOREVER) != 0) {
        return (int32_t)TFM_ERROR_GENERIC;
    }

    int32_t result = fn(arg0, arg1, arg2, arg3);
    k_mutex_unlock(&tfm_mutex);
    return result;
}

enum tfm_status_e tfm_ns_interface_init(void)
{
    // The static K_MUTEX_DEFINE handles mutex init, so just return.
    return TFM_SUCCESS;
}
```

## src/app_tfm_psa_its.c
```c
/* 
 * File:   app_tfm_psa_its.c
 * Author: makmorit
 *
 * Created on 2021/04/22, 12:21
 */
#include <zephyr.h>
#include <logging/log_ctrl.h>
#include <logging/log.h>

#include "psa/error.h"
#include "psa/internal_trusted_storage.h"

#include "app_tfm_psa_its.h"

#define LOG_LEVEL LOG_LEVEL_DBG
LOG_MODULE_REGISTER(app_tfm_psa_its);

// for debug data
#define LOG_DEBUG_ITS_DATA      false

//
// for Internal Trusted Storage
//
static uint8_t m_work_buf[32];

bool app_tfm_psa_its_data_read(uint16_t record_id, uint8_t *record_data, size_t *record_size, bool *is_exist)
{
    // 引数のフラグを初期化
    *is_exist = false;

    // メタデータ格納用
    struct psa_storage_info_t p_info;
    psa_storage_uid_t uid = record_id;

    // Protected Storage のメタデータを取得
    memset(&p_info, 0, sizeof(p_info));
    psa_status_t status = psa_its_get_info(uid, &p_info);
    if (status == PSA_ERROR_DOES_NOT_EXIST) {
        return true;

    } else if (status == PSA_SUCCESS) {
        // Internal Trusted Storage から読込み
        size_t data_offset = 0;
        size_t data_length;
        status = psa_its_get(uid, data_offset, p_info.size, (void *)m_work_buf, &data_length);
        if (status == PSA_SUCCESS) {
#if LOG_DEBUG_ITS_DATA
            // for debug
            LOG_HEXDUMP_DBG(m_work_buf, p_info.size, "psa_its_get");
#endif
            // レコードからデータを抽出
            //   version: 2バイト
            //   size:    2バイト
            //   data:    可変長
            uint16_t *p_size = (uint16_t *)(m_work_buf + 2);
            *record_size = *p_size;
            memcpy(record_data, m_work_buf + 4, *p_size);
            memset(m_work_buf, 0, sizeof(m_work_buf));

            // 引数のフラグに設定
            *is_exist = true;
            return true;
        }

        // 異常終了時は false を戻す
        LOG_ERR("psa_its_get returns %d", status);
        return false;
    }

    // 異常終了時は false を戻す
    LOG_ERR("psa_its_get_info returns %d", status);
    return false;
}

bool app_tfm_psa_its_data_write(uint16_t record_id, uint8_t *record_data, size_t record_size)
{
    psa_storage_uid_t uid = record_id;
    uint16_t version = PSA_ITS_RECORD_VERSION;

    // 引数のデータからレコードを生成
    //   version: 2バイト
    //   size:    2バイト
    //   data:    可変長
    memcpy(m_work_buf, (uint8_t *)(&version), sizeof(uint16_t));
    memcpy(m_work_buf + 2, (uint8_t *)(&record_size), sizeof(uint16_t));
    memcpy(m_work_buf + 4, record_data, record_size);
    psa_status_t status = psa_its_set(uid, record_size + 4, (void *)m_work_buf, PSA_STORAGE_FLAG_NONE);
    if (status == PSA_SUCCESS) {
        return true;
    }

    // 異常終了時は false を戻す
    LOG_ERR("psa_its_set returns %d", status);
    return false;
}
```

## src/app_tfm_psa_its.h
```c
/* 
 * File:   app_tfm_psa_its.h
 * Author: makmorit
 *
 * Created on 2021/04/22, 12:21
 */
#ifndef APP_TFM_PSA_ITS_H
#define APP_TFM_PSA_ITS_H

#include <stdbool.h>
#include <stddef.h>
#include <stdint.h>

#ifdef __cplusplus
extern "C" {
#endif

//
// レコードバージョン
//
#define PSA_ITS_RECORD_VERSION          (0x00000001)

//
// レコードUID
//
#define PSA_ITS_TEST_RECORD_KEY         (0x0000AFFF)

//
// 関数群
//
bool        app_tfm_psa_its_data_read(uint16_t record_id, uint8_t *record_data, size_t *record_size, bool *is_exist);
bool        app_tfm_psa_its_data_write(uint16_t record_id, uint8_t *record_data, size_t record_size);

#ifdef __cplusplus
}
#endif

#endif /* APP_TFM_PSA_ITS_H */
```

## src/app_tfm_psa_ps.c
```c
/* 
 * File:   app_tfm_psa_ps.c
 * Author: makmorit
 *
 * Created on 2021/04/22, 12:21
 */
#include <zephyr.h>
#include <logging/log_ctrl.h>
#include <logging/log.h>

#include "psa/error.h"
#include "psa/protected_storage.h"

#include "app_tfm_psa_ps.h"

#define LOG_LEVEL LOG_LEVEL_DBG
LOG_MODULE_REGISTER(app_tfm_psa_ps);

// for debug data
#define LOG_DEBUG_PS_DATA       false

//
// for Protected Storage
//
static uint8_t m_work_buf[32];

bool app_tfm_psa_ps_data_read(uint16_t record_id, uint8_t *record_data, size_t *record_size, bool *is_exist)
{
    // 引数のフラグを初期化
    *is_exist = false;

    // メタデータ格納用
    struct psa_storage_info_t p_info;
    psa_storage_uid_t uid = record_id;

    // Protected Storage のメタデータを取得
    memset(&p_info, 0, sizeof(p_info));
    psa_status_t status = psa_ps_get_info(uid, &p_info);
    if (status == PSA_ERROR_DOES_NOT_EXIST) {
        return true;

    } else if (status == PSA_SUCCESS) {
        // Protected Storage から読込み
        size_t data_offset = 0;
        size_t data_length;
        status = psa_ps_get(uid, data_offset, p_info.size, (void *)m_work_buf, &data_length);
        if (status == PSA_SUCCESS) {
#if LOG_DEBUG_PS_DATA
            // for debug
            LOG_HEXDUMP_DBG(m_work_buf, p_info.size, "psa_ps_get");
#endif
            // レコードからデータを抽出
            //   version: 2バイト
            //   size:    2バイト
            //   data:    可変長
            uint16_t *p_size = (uint16_t *)(m_work_buf + 2);
            *record_size = *p_size;
            memcpy(record_data, m_work_buf + 4, *p_size);
            memset(m_work_buf, 0, sizeof(m_work_buf));

            // 引数のフラグに設定
            *is_exist = true;
            return true;
        }

        // 異常終了時は false を戻す
        LOG_ERR("psa_ps_get returns %d", status);
        return false;
    }

    // 異常終了時は false を戻す
    LOG_ERR("psa_ps_get_info returns %d", status);
    return false;
}

bool app_tfm_psa_ps_data_write(uint16_t record_id, uint8_t *record_data, size_t record_size)
{
    psa_storage_uid_t uid = record_id;
    uint16_t version = PSA_PS_RECORD_VERSION;

    // 引数のデータからレコードを生成
    //   version: 2バイト
    //   size:    2バイト
    //   data:    可変長
    memcpy(m_work_buf, (uint8_t *)(&version), sizeof(uint16_t));
    memcpy(m_work_buf + 2, (uint8_t *)(&record_size), sizeof(uint16_t));
    memcpy(m_work_buf + 4, record_data, record_size);
    psa_status_t status = psa_ps_set(uid, record_size + 4, (void *)m_work_buf, PSA_STORAGE_FLAG_NONE);
    if (status == PSA_SUCCESS) {
        return true;
    }

    // 異常終了時は false を戻す
    LOG_ERR("psa_ps_set returns %d", status);
    return false;
}
```

## src/app_tfm_psa_ps.h
```c
/* 
 * File:   app_tfm_psa_ps.h
 * Author: makmorit
 *
 * Created on 2021/04/22, 12:21
 */
#ifndef APP_TFM_PSA_PS_H
#define APP_TFM_PSA_PS_H

#include <stdbool.h>
#include <stddef.h>
#include <stdint.h>

#ifdef __cplusplus
extern "C" {
#endif

//
// レコードバージョン
//
#define PSA_PS_RECORD_VERSION           (0x00000001)

//
// レコードUID
//
#define PSA_PS_TEST_RECORD_KEY          (0x0000BFFF)

//
// 関数群
//
bool        app_tfm_psa_ps_data_read(uint16_t record_id, uint8_t *record_data, size_t *record_size, bool *is_exist);
bool        app_tfm_psa_ps_data_write(uint16_t record_id, uint8_t *record_data, size_t record_size);

#ifdef __cplusplus
}
#endif

#endif /* APP_TFM_PSA_PS_H */
```

## src/psa_attestation.c
```c
/*
 * Copyright (c) 2019,2020 Linaro Limited
 *
 * SPDX-License-Identifier: Apache-2.0
 */

#include <zephyr.h>
#include <stdio.h>
#include <logging/log.h>

#include "psa/initial_attestation.h"
#include "psa_attestation.h"
#include "util_app_log.h"
#include "util_sformat.h"

LOG_MODULE_DECLARE(app, CONFIG_LOG_DEFAULT_LEVEL);

#if ORIGINAL_SOURCE
psa_status_t att_get_pub_key(void)
{
	psa_status_t err = PSA_SUCCESS;

	/* TODO: How to retrieve this?!? */

	/* Log any eventual errors via app_log */
	return err ? al_psa_status(err, __func__) : err;
}
#endif
psa_status_t att_get_iat(uint8_t *ch_buffer, uint32_t ch_sz,
			 uint8_t *token_buffer, uint32_t *token_sz)
{
	psa_status_t err = PSA_SUCCESS;
	uint32_t sys_token_sz;
	size_t token_buf_size = ATT_MAX_TOKEN_SIZE;


	/* Call with with bigger challenge object than allowed */

	/*
	 * First determine how large the token is on this system.
	 * We don't need to compare with the size of ATT_MAX_TOKEN_SIZE here
	 * since a check will be made in 'psa_initial_attest_get_token' and the
	 * error return code will indicate a mismatch.
	 */
	switch (ch_sz) {
	case 32:
		err = psa_initial_attest_get_token(
			ch_buffer,
			PSA_INITIAL_ATTEST_CHALLENGE_SIZE_32,
			token_buffer,
			token_buf_size,
			&sys_token_sz);
		break;
	case 48:
		err = psa_initial_attest_get_token(
			ch_buffer,
			PSA_INITIAL_ATTEST_CHALLENGE_SIZE_48,
			token_buffer,
			token_buf_size,
			&sys_token_sz);
		break;
	case 64:
		err = psa_initial_attest_get_token(
			ch_buffer,
			PSA_INITIAL_ATTEST_CHALLENGE_SIZE_64,
			token_buffer,
			token_buf_size,
			&sys_token_sz);
		break;
	}
	LOG_INF("att: System IAT size is: %d bytes.", sys_token_sz);
	if (err) {
		goto err;
	}

	/* Request the initial attestation token w/the challenge data. */
	LOG_INF("att: Requesting IAT with %d byte challenge.", ch_sz);
	err = psa_initial_attest_get_token(
		ch_buffer,      /* Challenge/nonce input buffer. */
		ch_sz,          /* Challenge size (32, 48 or 64). */
		token_buffer,   /* Token output buffer. */
		token_buf_size,
		token_sz        /* Post exec output token size. */
		);
	LOG_INF("att: IAT data received: %d bytes.", *token_sz);

err:
	/* Log any eventual errors via app_log */
	return err ? al_psa_status(err, __func__) : err;
}

psa_status_t att_test(void)
{
	psa_status_t err = PSA_SUCCESS;

	/* 64-bytee nonce/challenge, encrypted using the default public key;
	 *
	 * 00 11 22 33 44 55 66 77 88 99 AA BB CC DD EE FF
	 * 00 11 22 33 44 55 66 77 88 99 AA BB CC DD EE FF
	 * 00 11 22 33 44 55 66 77 88 99 AA BB CC DD EE FF
	 * 00 11 22 33 44 55 66 77 88 99 AA BB CC DD EE FF
	 */
	uint32_t nonce_sz = 64;
	uint8_t nonce_buf[ATT_MAX_TOKEN_SIZE] = {
		0x00, 0x11, 0x22, 0x33, 0x44, 0x55, 0x66, 0x77,
		0x88, 0x99, 0xAA, 0xBB, 0xCC, 0xDD, 0xEE, 0xFF,
		0x00, 0x11, 0x22, 0x33, 0x44, 0x55, 0x66, 0x77,
		0x88, 0x99, 0xAA, 0xBB, 0xCC, 0xDD, 0xEE, 0xFF,
		0x00, 0x11, 0x22, 0x33, 0x44, 0x55, 0x66, 0x77,
		0x88, 0x99, 0xAA, 0xBB, 0xCC, 0xDD, 0xEE, 0xFF,
		0x00, 0x11, 0x22, 0x33, 0x44, 0x55, 0x66, 0x77,
		0x88, 0x99, 0xAA, 0xBB, 0xCC, 0xDD, 0xEE, 0xFF,
		0
	};

	/* IAT response buffer. */
	uint32_t iat_sz = ATT_MAX_TOKEN_SIZE;
	uint8_t iat_buf[ATT_MAX_TOKEN_SIZE] = { 0 };

	/* String format output config. */
	struct sf_hex_tbl_fmt fmt = {
		.ascii = true,
		.addr_label = true,
		.addr = 0
	};

	/* Request the IAT from the initial attestation service. */
	err = att_get_iat(nonce_buf, nonce_sz, iat_buf, &iat_sz);
	if (err) {
		goto err;
	}

	/* Display queued log messages before dumping the IAT. */
	al_dump_log();

	/* Dump the IAT for debug purposes. */
	sf_hex_tabulate_16(&fmt, iat_buf, (size_t)iat_sz);

err:
	return err;
}
```

## src/tfm_ipc.c
```c
/*
 * Copyright (c) 2019,2020 Linaro Limited
 *
 * SPDX-License-Identifier: Apache-2.0
 */

#include <zephyr.h>

#include "tfm_api.h"
#include "tfm_ns_interface.h"

K_MUTEX_DEFINE(tfm_mutex);

#if ORIGINAL_SOURCE
int32_t tfm_ns_interface_dispatch(veneer_fn fn,
				uint32_t arg0, uint32_t arg1,
				uint32_t arg2, uint32_t arg3)
{
	int32_t result;

	/* TFM request protected by NS lock */
	if (k_mutex_lock(&tfm_mutex, K_FOREVER) != 0) {
		return (int32_t)TFM_ERROR_GENERIC;
	}

	result = fn(arg0, arg1, arg2, arg3);

	k_mutex_unlock(&tfm_mutex);

	return result;
}
#endif

enum tfm_status_e tfm_ns_interface_init(void)
{
	/* The static K_MUTEX_DEFINE handles mutex init, so just return. */

	return TFM_SUCCESS;
}
```
